## enable-wifi/Config.in
```kconfig
menu "Configuration"
	depends on PACKAGE_enable-wifi

config WIFI_SSID
		string
		prompt "WiFi SSID"
		default "OpenWrt"
		help
			WiFi SSID used for automatically created access points.

config WIFI_ENCRYPTION
		string
		prompt "WiFi Encryption"
		default "none"
		help
			WiFi encryption used for automatically created access points.

			Supported modes:
			none - No encryption
			owe - OWE
			sae - WPA3 Pers.
			sae-mixed - WPA2/WPA3 Pers.
			psk2 - WPA2 Pers.
			psk - WPA Pers.

config WIFI_KEY
		string
		prompt "WiFi Key"
		default ""
		help
			WiFi key used for automatically created access points.
			Requires at least eight (8) characters.

endmenu
```
